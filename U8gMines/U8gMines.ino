#include <Arduino.h>
#include <U8g2lib.h>
#ifdef U8X8_HAVE_HW_SPI
#include <SPI.h>
#endif
#ifdef U8X8_HAVE_HW_I2C
#include <Wire.h>
#endif
U8G2_SSD1306_128X64_NONAME_F_HW_I2C u8g2(U8G2_R0, /* reset=*/ U8X8_PIN_NONE);
/*=========================================================
                      自定义按键
  =========================================================*/
#define UP 17//定义方向键上为Arduino上的11号引脚
#define DOWN 2//定义方向键上为Arduino上的10号引脚
#define LEFT 15//定义方向键上为Arduino上的9号引脚
#define RIGHT 3//定义方向键上为Arduino上的8号引脚
#define A 4//定义方向键上为Arduino上的7号引脚
#define B 16//定义方向键上为Arduino上的6号引脚
/*=========================================================
                         位图
  =========================================================*/
//HWT 作者信息 请勿删除
const uint8_t HWT[] PROGMEM = {0x30,0x00,0x00,0x00,0x00,0x00,0x00,0x00,0x00,0xcc,0xc0,0x98,0x79,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0x00,0x00};
//社会核心价值观
const uint8_t CSV[] PROGMEM = {0xff,0xff,0xff,0xff,0xff,0xff,0xff,0xff,0xff,0xff,0xff,0xff,0xff,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0xff,0xff};
/*=========================================================
  变量
  =========================================================*/
byte x, y;
byte PX, PY; //玩家坐标
byte sx; //当前地图大小
byte KeyBack; //按键返回值
byte MAP[18][8]; //游戏地图
bool OMAP[18][8]; //遮挡地图
unsigned long GT; //游戏倒计时
/*
   0为空
   1-254 为距离
   255为地雷
*/
byte LEVEL = 1; //关卡
/*
     关卡 大小 雷数   难度
     1    8*8  10     16.625
     2    8*10 14     17.5
     3    8*12 18     18.75
     4    8*14 22     19.642
     5    8*16 26     20.312
     6    8*18 30     20.833

     大小:8*(8+(n-1)*2)
     雷数:10+(n-1)*4
*/
byte mines[2];
/*=========================================================
  只循环一次
  =========================================================*/
void setup() {
  u8g2.begin();
  //初始化按钮
  pinMode(UP, INPUT);//定义方向UP引脚状态
  pinMode(DOWN, INPUT);//定义方向DOWN引脚状态
  pinMode(LEFT, INPUT);//定义方向LEFT引脚状态
  pinMode(RIGHT, INPUT);//定义方向RIGHT引脚状态
  pinMode(A, INPUT);//定义按键A引脚状态
  pinMode(B, INPUT);//定义按键B引脚状态
  Serial.begin(9600);
  u8g2.setFont(u8g2_font_5x7_tf);
  
    for (int i = 63; i >= -8; i--) {
      u8g2.clearBuffer();
     // u8g2.drawXBMP(26, i, 72, 8, HWT);
      //u8g2.drawXBMP(0, i + 8, 128, 64, CSV);
      u8g2.sendBuffer();
    }
  
  delay(1000);
  GenerateMap(); //生成地图
}
/*=========================================================
                     不停循环
  =========================================================*/
void loop() {
  key(); //按键扫描
  logic(); //逻辑
  draw(); //绘图
  //DEBUG();
}

/*=========================================================
  生成地图 和 初始化游戏
  =========================================================*/
void GenerateMap() {
  sx = 8 + (LEVEL - 1) * 2;
  PX = sx / 2.0;
  PY = 4;
  //清空地图
  for (y = 0; y < 8; y++) {
    for (x = 0; x < sx; x++) {
      MAP[x][y] = 0;
      OMAP[x][y] = true;
    }
  }
  //生成地雷
  mines[1] = 10 + (LEVEL - 1) * 4; //计算当前关卡要生成颗地雷
  for (mines[0] = 0; mines[0] < mines[1];) {
    //随机生成地雷坐标
    x = random(sx);
    y = random(8);
    if (MAP[x][y] == 0) {  //判断随机位置是否为地雷，是的话重新生成
      //  Serial.println(String("[ ") + x + String(" ] ") + String("[ ") + y + String(" ]"));
      MAP[x][y] = 255; //设置地雷
      mines[0]++;
    }
  }
  mines[0] = 0;
  //计算与雷的距离
  for (y = 0; y < 8; y++) {
    for (x = 0; x < sx; x++) {
      if (MAP[x][y] != 255) {
        //该位置不是雷，计算附近3*3有多少雷
        for (int my = -1; my < 2; my++) {
          for (int mx = -1; mx < 2; mx++) if (MAP[x + mx][y + my] == 255 && x + mx >= 0 && y + my >= 0 && x + mx < sx && y + my < 8) MAP[x][y]++;
        }
      }
    }
  }
  GT = millis() / 1000;
}
/*=========================================================
  按键扫描
  =========================================================*/
void key() {
  /*
      0  1  2  3  4  5
      ↑ ↓← →  A  B
  */
  KeyBack = 255;
  if (digitalRead(UP) == LOW) KeyBack = 0;
  if (digitalRead(DOWN) == LOW) KeyBack = 1;
  if (digitalRead(LEFT) == LOW) KeyBack = 2;
  if (digitalRead(RIGHT) == LOW) KeyBack = 3;
  if (digitalRead(A) == LOW) KeyBack = 4;
  if (digitalRead(B) == LOW) KeyBack = 5;
}
/*=========================================================
  绘图
  =========================================================*/
void draw() {
  u8g2.clearBuffer();
    byte x, y;
    u8g2.setCursor(0, 8);
    //显示扫雷地图
    mines[0] = 0;
    for (y = 0; y < 8; y++) {
      for (x = 0; x < sx; x++) {
        u8g2.setCursor(x * 6, y * 8 + 8);
        if (OMAP[x][y] == false || MAP[PX][PY] == 254) {
          if (MAP[x][y] == 255) {
            u8g2.print(F("^"));
          } else if (MAP[x][y] == 0) {
            u8g2.print(F("."));
          } else {
            if (MAP[x][y] != 254) u8g2.print(MAP[x][y]);
          }
        } else {
          u8g2.print(F("+"));
          mines[0]++;
        }
      }
    }
    //判定是否通关
    if (mines[0] == mines[1]) win();
    //显示状态栏
    u8g2.drawLine(108, 0, 108, 64);
    u8g2.setCursor(110, 24 + 8);
    u8g2.print(mines[0]);
    u8g2.setCursor(116, 32 + 8);
    u8g2.print(F("/"));
    u8g2.setCursor(110, 40 + 8);
    u8g2.print(mines[1]);
    //显示光标 以及状态栏表情
    u8g2.setCursor(PX * 6, PY * 8 + 8);
    if (MAP[PX][PY] == 254) {
      u8g2.print(F("*"));
      u8g2.setCursor(110, 8);
      u8g2.print(F(":("));
    } else {
      u8g2.print(F("@"));
      u8g2.setCursor(110, 8);
      u8g2.print(F(":)"));
    }
    //显示游戏剩余时间
    u8g2.setCursor(110, 16);
    u8g2.print(300 + GT - millis() / 1000);
  u8g2.sendBuffer();
}
/*=========================================================
  DEBUG
  =========================================================*/
void DEBUG() {
  Serial.println("=======DEBUG=======");
  for (y = 0; y < 8; y++) {
    for (x = 0; x < sx; x++) {
      if (MAP[x][y] == 255) {
        Serial.print(F("X"));
      } else {
        Serial.print(MAP[x][y]);
      }
    }
    Serial.println();
  }
  Serial.println("=======OMAP=======");
  for (y = 0; y < 8; y++) {
    for (x = 0; x < sx; x++) {
      Serial.print(OMAP[x][y]);
    }
    Serial.println();
  }
  Serial.println();
  Serial.print(F(""));
  Serial.println();
}
/*=========================================================
  逻辑
  =========================================================*/
void logic() {
  //按键返回
  switch (KeyBack) {
    case 0:
      if (PY != 0) PY--;
      break;
    case 1:
      if (PY != 7) PY++;
      break;
    case 2:
      if (PX != 0) PX--;
      break;
    case 3:
      if (PX < sx - 1) PX++;
      break;
    case 4:
      OMAP[PX][PY] = false; //做标记 这个位置挖开了
      if (MAP[PX][PY] == 255) {
        MAP[PX][PY] = 254;
        fail();
      } else if (MAP[PX][PY] == 0) {
        BOOM();
      }
      break;
    case 5:
      break;
  }
  //判断是否超时
  if (millis() / 1000.0 >= GT + 300) fail(); //游戏超时 游戏结束
}
/*=========================================================
                  下一关
  =========================================================*/
void win() {
  u8g2.clearBuffer();
    for (y = 0; y < 8; y++) {
      for (x = 0; x < sx; x += 3) {
        u8g2.setCursor(x * 6, y * 8 + 8);         //设置光标
        u8g2.print(F("WIN"));                 //打印 你赢了
        u8g2.sendBuffer();
        delay(10);
      }
    }
  delay(5000);
  if (LEVEL != 6) LEVEL++;
  GenerateMap();
}
/*=========================================================
                  失败
  =========================================================*/
void fail() {
  draw();
  delay(5000);
  GenerateMap();
}
/*=========================================================
  BOOM  炸开一片区域 通常程序会在空白时候调用
  =========================================================*/
void BOOM() {
SBOOM:
  MAP[PX][PY] = 253;
  bool Change = false;
  for (y = 0; y < 8; y++) {
    for (x = 0; x < sx; x++) {
      //开始遍历地图
      for (int my = -1; my < 2; my++) {
        for (int mx = -1; mx < 2; mx++) {
          if (x + mx >= 0 && y + my >= 0 && x + mx < sx && y + my < 8) { //防止内存越界
            if (MAP[x + mx][y + my] == 0 && MAP[x][y] == 253) {
              Change = true;
              MAP[x + mx][y + my] = 253;
            }
          }
        }
      }
    }
  }
  if (Change == true) goto SBOOM;
  for (y = 0; y < 8; y++) {
    for (x = 0; x < sx; x++) {
      if (MAP[x][y] == 253) {
        MAP[x][y] = 0;
        for (int my = -1; my < 2; my++) {
          for (int mx = -1; mx < 2; mx++) {
            if (x + mx >= 0 && y + my >= 0 && x + mx < sx && y + my < 8) { //防止内存越界
              OMAP[x + mx][y + my] = false;
            }
          }
        }
      }
    }
  }
}

